# file: Clase2_Ejemplo.ioc
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Mcu.Family=STM32F4
Mcu.Name=STM32F401R(D-E)Tx
Mcu.Package=LQFP64
NVIC.PriorityGroup=NVIC_PRIORITYGROUP_4
ProjectManager.HeapSize=0x200
ProjectManager.StackSize=0x400
ProjectManager.TargetToolchain=STM32CubeIDE
RCC.AHBFreq_Value=16000000
RCC.APB1Freq_Value=16000000
RCC.APB2Freq_Value=16000000
RCC.CortexFreq_Value=16000000
RCC.HSE_VALUE=25000000
RCC.HSI_VALUE=16000000
RCC.LSE_VALUE=32768
RCC.SYSCLKFreq_VALUE=16000000
RCC.VCOOutputFreq_Value=192000000
board=custom

// file: Core/Src/main.c
/* USER CODE BEGIN Header */
/**
  ******************************************************************************
  * @file           : main.c
  * @brief          : Main program body
  ******************************************************************************
  * @attention
  *
  * <h2><center>&copy; Copyright (c) 2020 STMicroelectronics.
  * All rights reserved.</center></h2>
  *
  * This software component is licensed by ST under BSD 3-Clause license,
  * the "License"; You may not use this file except in compliance with the
  * License. You may obtain a copy of the License at:
  *                        opensource.org/licenses/BSD-3-Clause
  *
  ******************************************************************************
  */
/* USER CODE END Header */
#include "main.h"
#include "stm32f401re.h"
#include "stdint.h"
#include "stdio.h"

void SystemClock_Config(void);

int main(void)
{

  /* MCU Configuration--------------------------------------------------------*/

  /* Reset of all peripherals, Initializes the Flash interface and the Systick. */
  //HAL_Init();

  /* Configure the system clock */
  //SystemClock_Config();

  /* Initialize all configured peripherals */
  /* USER CODE BEGIN 2 */

	/*Configuracion para el HSI de 16MHz*/

//	FLASH -> ACR |= (1<<8)|(1<<9)|(1<<10)|(1<<11); //Bits se la flas
//	FLASH -> ACR &= ~((1<<1)|(1<<2)|(1<<3)); //Para 16Mhz -> 0 WS
//
//	RCC -> CR |= (1<<0);	//HSI Oscillator en el modo ON
//
//	while(!(RCC-> CR & (1<<1)));	//HSIRDY para confirmar si es estable el HSI
//
//	/*Configuracion del SYSTICK*/
//
//	//Cada vez que el systick llega a 0, ocurre una interrupción
//	HAL_NVIC_SetPriorityGrouping(NVIC_PRIORITYGROUP_4);
//	HAL_NVIC_SetPriority(SysTick_IRQn, 0, 0);
//
//	//Cargar valor para el systick
//	SysTick -> LOAD = 16000 - 1;				//Valor de recarga
//	SysTick -> VAL = 0;							//Inicie con 0
//	SysTick -> CTRL = (1<<2)|(1<<1)|(1<<0);	//Habilitar SysTick

	/*Configuracion para el HSE de 84MHz*/

	//Como ahora se trabaj en HSE CLOCK EXTERNO que proviene del
	//programador

	/*	84Mhz = FREQ_IN * N
	 * 			-----------  / AHB_PRESCALER
	 * 				M * P
	 * 	FREQ_IN = 8Mhz
	 * 	M = 4	PLLM
	 * 	P = 2	PLLP
	 * 	N = 84 	PLLN
	 * 	AHB_PRE = 1
	 *
	 * 	-> 84Mhz
	 *
	 */

	FLASH -> ACR |= (1<<8)|(1<<9)|(1<<10)|(1<<11);

	FLASH -> ACR &= ~((1<<0)|(1<<2));	//2 WS
	FLASH -> ACR |= (1<<1);

	RCC -> CR |= (1<<16);	//HSE ON

	while(!(RCC -> CR & (1<<17)));

	// PLL

	//Inicializando
	RCC -> PLLCFGR = 0;

	//PLLM
	RCC -> PLLCFGR &= ~((1<<5)|(1<<4)|(1<<3)|(1<<1)|(1<<0));
	RCC -> PLLCFGR |=(1<<2);

	//PLLN
	RCC -> PLLCFGR &= ~((1<<6)|(1<<7)|(1<<9)|(1<<11)|(1<<13)|(1<<14));
	RCC -> PLLCFGR |=(1<<8)|(1<<10)|(1<<12);

	//PLLP
	RCC -> PLLCFGR &= ~((1<<17)|(1<<16));

	//AHB_PRES
	RCC -> CFGR &= ~((1<<7)|(1<<6)|(1<<5)|(1<<4));

	//Prescaler para APB1 MAX 42 divided by 2
	RCC -> CFGR |= (1<<12);
	RCC -> CFGR &= ~((1<<11)|(1<<10));

	//Prescaler para APB2 MAX 84 no divided
	RCC -> CFGR &= ~((1<<13)|(1<<14)|(1<<15));

	//Habilitar PLL para MODO HSE
	RCC -> PLLCFGR |= (1<<22);

	//PLL como CLOCK del sistema
	RCC -> CFGR |= (1<<1);
	RCC -> CFGR &= ~(1<<0);

	//PLL usado como CLOCK del sistema
	RCC -> CFGR |= (1<<3);
	RCC -> CFGR &= ~(1<<2);

	//PLL ON
	RCC -> CR |= (1<<24);
	while(!(RCC -> CR & (1<<25)));	//STANDBY

	//Cambiando el systick

	HAL_NVIC_SetPriorityGrouping(NVIC_PRIORITYGROUP_4);
	HAL_NVIC_SetPriority(SysTick_IRQn, 0, 0);

	SysTick -> LOAD = 84000-1;
	SysTick -> VAL = 0;
	SysTick -> CTRL |= ((1<<2)|(1<<1)|(1<<0));
	//////////////////////////////////////////////////

	/*Inicializacion de led*/
	Led_Init();

  /* USER CODE END 2 */

  /* Infinite loop */
  /* USER CODE BEGIN WHILE */
  while (1)
  {
	  /*Parpadeo de led*/
	  Led_Toggle();
	  HAL_Delay(1000);

    /* USER CODE END WHILE */

  }
}

void SystemClock_Config(void)
{
  RCC_OscInitTypeDef RCC_OscInitStruct = {0};
  RCC_ClkInitTypeDef RCC_ClkInitStruct = {0};

  /** Configure the main internal regulator output voltage
  */
  __HAL_RCC_PWR_CLK_ENABLE();
  __HAL_PWR_VOLTAGESCALING_CONFIG(PWR_REGULATOR_VOLTAGE_SCALE2);
  /** Initializes the RCC Oscillators according to the specified parameters
  * in the RCC_OscInitTypeDef structure.
  */
  RCC_OscInitStruct.OscillatorType = RCC_OSCILLATORTYPE_HSI;
  RCC_OscInitStruct.HSIState = RCC_HSI_ON;
  RCC_OscInitStruct.HSICalibrationValue = RCC_HSICALIBRATION_DEFAULT;
  RCC_OscInitStruct.PLL.PLLState = RCC_PLL_NONE;
  if (HAL_RCC_OscConfig(&RCC_OscInitStruct) != HAL_OK)
  {
    Error_Handler();
  }
  /** Initializes the CPU, AHB and APB buses clocks
  */
  RCC_ClkInitStruct.ClockType = RCC_CLOCKTYPE_HCLK|RCC_CLOCKTYPE_SYSCLK
                              |RCC_CLOCKTYPE_PCLK1|RCC_CLOCKTYPE_PCLK2;
  RCC_ClkInitStruct.SYSCLKSource = RCC_SYSCLKSOURCE_HSI;
  RCC_ClkInitStruct.AHBCLKDivider = RCC_SYSCLK_DIV1;
  RCC_ClkInitStruct.APB1CLKDivider = RCC_HCLK_DIV1;
  RCC_ClkInitStruct.APB2CLKDivider = RCC_HCLK_DIV1;

  if (HAL_RCC_ClockConfig(&RCC_ClkInitStruct, FLASH_LATENCY_0) != HAL_OK)
  {
    Error_Handler();
  }
}

void Error_Handler(void)
{
}

/************************ (C) COPYRIGHT STMicroelectronics *****END OF FILE****/
